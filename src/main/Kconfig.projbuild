## src/main/Kconfig.projbuild
```kconfig
menu "Project configuration"
    config PROJECT_DEVICE_LOCATION
        string "Location of the device"
        default "somewhere"
        help
            Localtion of the device. Typically, room name, property's name, or
            even country name. This value will be included in metrics so that
            you can filter metrics by location.
    config PROJECT_WIFI_SSID
        string "WiFi SSID"
        default "myssid"
        help
            WiFi SSID to connnect
    config PROJECT_WIFI_PASSWORD
        string "WiFi password"
        default "mypassword"
        help
            WiFi password
    config PROJECT_MQTT_BROKER_URI
        string "MQTT broaker URI"
        default "mqtt://test.mosquitto.org:1883"
    config PROJECT_TLS_MQTT
        bool "MQTT connection requires TLS"
        default false
        help
            Select this if MQTT connection requires TLS.
    config PROJECT_TLS_MQTT_NO_VERIFY
        bool "Disable TLS verification in MQTT"
        default false
        help
            If set to true, TLS verification will not be performed.
    config PROJECT_MQTT_USER
        string "MQTT user name"
        default ""
        help
            MQTT user name, if any
    config PROJECT_MQTT_PASSWORD
        string "MQTT password"
        default ""
        help
            MQTT password, if any
    config PROJECT_LATEST_APP_URL
        string "URL to the latest application"
        default "https://192.168.1.54:8070/build/roomPing.bin"
    config PROJECT_TLS_OTA
        bool "HTTP OTA requires TLS"
        default true
        help
            Select this if HTTP OTA requires TLS.
    config PROJECT_TLS_OTA_NO_VERIFY
        bool "Disable TLS verification in OTA"
        default false
        help
            If set to true, TLS verification will not be performed.
    config PROJECT_SNTP_HOST
        string "SNTP hostname"
        default "pool.ntp.org"
        help
            SNTP server to sync time with.
    config PROJECT_MAX_TARGET_STRING_SIZE
        int "Max size of target hostname"
        default 32
    config PROJECT_METRIC_QUEUE_SIZE
        int "Size of metric queue"
        default 10
    config PROJECT_PING_INTERVAL_SEC
        int "Ping test interval in sec"
        default 300
    config PROJECT_PING_COUNT
        int "Number of ICMP packets to send"
        default 15
    config PROJECT_OTA_ENABLED
        bool "Enable OTA command"
        default true
        help
            If selected, enable OTA command topic.
    config PROJECT_REBOOT_ENABLED
        bool "Enable reboot command"
        default true
        help
            If selected, enable reboot command topic.
    config PROJECT_METRIC_INFLUX_MAX_LEN
        int "Max length of influx payload"
        default 512
        help
            Max length of lnflux payload.
endmenu
```
